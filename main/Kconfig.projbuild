## main/Kconfig.projbuild
```kconfig
menu "bluedap configuration"
    config PIN_SWCLK
        int "SWCLK pin"
        range 0 48
        default 4
        help
            GPIO number for SWCLK (SWD clock) pin.

    config PIN_SWDIO
        int "SWDIO pin"
        range 0 48
        default 5
        help
            GPIO number for SWDIO (SWD data input/output) pin.

    config PIN_NRESET
        int "nRESET pin"
        range 0 48
        default 6
        help
            GPIO number for nRESET (reset signal for target device) pin.
    
    config USE_PIN_AUTH
        bool "Use PIN code authentication"
        default y
        help
            Use PIN code authentication during pairing. This is recommended for security.
    
    config DEVICE_NAME
        string "Device name"
        default "bluedap CMSIS-DAP"
        help
            Name of the debug probe. It must contain "CMSIS-DAP" to be recognized by debugging software.
    
    config VID
        hex "Vendor ID"
        default 0xDEAD
        range 0x0 0xFFFF
        help
            Vendor ID (VID) as defined in the USB spec.
    
    config PID
        hex "Product ID"
        default 0xBEEF
        range 0x0 0xFFFF
        help
            Product ID (PID) as defined in the USB spec.
    
    config PRODUCT_VERSION
        hex "Device version"
        default 0x0001
        range 0x0 0xFFFF
        help
            Product version in binary-coded decimal (BCD) format.
    
    config ENABLE_SERIAL
        bool "Enable virtual serial port"
        default y
        help
            Enable virtual serial port over BLE using Nordic UART Service.
    
    config SERIAL_INITIAL_BAUD
        int "Serial port initial baud rate"
        default 115200
        range 1 10000000
        depends on ENABLE_SERIAL
        help
            Baud rate of the serial port.
    
    config PIN_TX
        int "Serial TX pin"
        range 0 48
        default 21
        depends on ENABLE_SERIAL
        help
            TX (transmit) pin of the serial port.

    config PIN_RX
        int "Serial RX pin"
        range 0 48
        default 20
        depends on ENABLE_SERIAL
        help
            RX (receive) pin of the serial port.
endmenu
```
